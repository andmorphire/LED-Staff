#include "FastLED.h"

// This sketch shows how to sequence a performance using HH,MM,SS.SSS timecode.
//
// A "ResetPerformance" method is provided so that the performance can be
// restarted from a custom external trigger, e.g., a button or event.
// For demonstration purposes, this Performance is reset if the
// sketch receives a letter "r" on the serial port.
//
// -Mark Kriegsman, January 2015

#if FASTLED_VERSION < 3001000
#error "Requires FastLED 3.1 or later; check github for latest code."
#endif

#define DATA_PIN    3
//#define CLK_PIN   4
#define LED_TYPE    WS2812B
#define COLOR_ORDER GRB
#define NUM_LEDS    90
CRGB leds[NUM_LEDS];

#define BRIGHTNESS          255
#define FRAMES_PER_SECOND  240


#define FREQUENCY     1                // controls the interval between strikes for lightning
#define FLASHES       5                 // the upper limit of flashes per strike for lightning
// #define color White; //for lightning- do we need this?
unsigned int dimmer = 1; // for lightning

uint8_t hue = 32;  //for meteor
byte idex = 255;   //for meteor
byte meteorLength = 29;  //for meteor


volatile uint8_t style = 0; //for strobe
volatile long lastRun = 0;  //for strobe
const uint8_t pause = 20;   //for strobe



void setup() {
  delay(300); // 0.3 second delay for recovery
  
  // tell FastLED about the LED strip configuration
  FastLED.addLeds<LED_TYPE,DATA_PIN,COLOR_ORDER>(leds, NUM_LEDS).setCorrection(TypicalLEDStrip);
  //FastLED.addLeds<LED_TYPE,DATA_PIN,CLK_PIN,COLOR_ORDER>(leds, NUM_LEDS).setCorrection(TypicalLEDStrip);

  // set master brightness control
  FastLED.setBrightness(BRIGHTNESS);
  
  // RestartPerformance();
  Serial.begin(57600);
}


uint8_t gHue = 0; // rotating "base color" used by many of the patterns
  
uint32_t gTimeCodeBase = 0;
uint32_t gTimeCode = 0;
uint32_t gLastTimeCodeDoneAt = 0;
uint32_t gLastTimeCodeDoneFrom = 0;

#define TC(HOURS,MINUTES,SECONDS) \
  ((uint32_t)(((uint32_t)((HOURS)*(uint32_t)(3600000))) + \
  ((uint32_t)((MINUTES)*(uint32_t)(60000))) + \
  ((uint32_t)((SECONDS)*(uint32_t)(1000)))))


#define AT(HOURS,MINUTES,SECONDS) if( atTC(TC(HOURS,MINUTES,SECONDS)) )
#define FROM(HOURS,MINUTES,SECONDS) if( fromTC(TC(HOURS,MINUTES,SECONDS)) )

static bool atTC( uint32_t tc)
{
  bool maybe = false;
  if( gTimeCode >= tc) {
    if( gLastTimeCodeDoneAt < tc) {
      maybe = true;
      gLastTimeCodeDoneAt = tc;
    }
  }
  return maybe;
}

static bool fromTC( uint32_t tc)
{
  bool maybe = false;
  if( gTimeCode >= tc) {
    if( gLastTimeCodeDoneFrom <= tc) {
      maybe = true;
      gLastTimeCodeDoneFrom = tc;
    }
  }
  return maybe;
}


// There are two kinds of things you can put into this performance:
// "FROM" and "AT".
//
// * "FROM" means starting FROM this time AND CALLING IT REPEATEDLY 
//   until the next "FROM" time comes.
//
// * "AT" means do this ONE TIME ONLY "AT" the designated time.
//
// At least one of the FROM clauses will ALWAYS be executed.
// In the transitional times, TWO pieces of code will be executed back to back.
// For example, if one piece says "FROM(0,0,1.000) {DrawRed()}" and another says
// "FROM(0,0,2.000) {flashblue();}", what you'll get is this:
//   00:00:01.950  -> calls DrawRed
//   00:00:01.975  -> calls DrawRed
//   00:00:02.000  -> calls DrawRed AND calls DrawBlue !
//   00:00:02.025  -> calls DrawBlue
//   00:00:02.050  -> calls DrawBlue
// In most cases, this probably isn't significant in practice, but it's important
// to note.  It could be avoided by listing the sequence steps in reverse
// chronological order, but that makes it hard to read.

void Performance()
{
    AT(0,0,00.001) { FastLED.setBrightness(BRIGHTNESS); }
  FROM(0,0,00.100) { confetti(); }
  FROM(0,0,04.020) { sinelon(); }
  FROM(0,0,11.510) { juggle(); }
  FROM(0,0,27.560) { bpm(); }
  FROM(0,0,32.000) { fadeToBlack(); }
  FROM(0,0,34.000) { strobe(); }
  FROM(0,0,38.550) { povC(); }
  FROM(0,0,51.050) { povA(); }
  FROM(0,1,07.030) { colorshift(); }
  FROM(0,1,21.050) { rainbowWithGlitter(); }
  FROM(0,1,35.330) { bpm(); }
  FROM(0,1,46.070) { sinelon(); }
  FROM(0,1,50.060) { juggle(); }
  FROM(0,2,02.010) { colorshift(); }
  FROM(0,2,15.810) { rainbowWithGlitter(); }
  FROM(0,2,25.000) { fadeToBlack(); }
  FROM(0,2,27.000) { strobe(); }
  FROM(0,2,29.500) { povD(); }
  FROM(0,2,34.500) { povB(); }
  FROM(0,2,40.500) { povC(); }
  FROM(0,2,46.520) { povA(); }
  FROM(0,3,00.000) { confetti(); }
  FROM(0,3,05.990) { fadeToBlack(); }
  // FROM(0,2,38.590) { confetti(); }
  // FROM(0,2,42.200) { povA(); }
//  FROM(0,2,49.000) { povB(); }
//  FROM(0,2,56.750) { colorshift(); }
//  FROM(0,3,08.750) { confetti(); }
//    AT(0,3,09.000)   { gHue = HUE_PINK; }
//    AT(0,3,10.000)   { fill_solid(leds, NUM_LEDS, CRGB::Red); }
//    AT(0,3,11.000)   { fill_solid(leds, NUM_LEDS, CRGB::Blue); } 
//  FROM(0,3,12.000) { applause(); }  
//    AT(0,3,13.000)   { FastLED.setBrightness(BRIGHTNESS/2); }
//    AT(0,3,14.000)   { FastLED.setBrightness(BRIGHTNESS/4); }
//    AT(0,3,15.000)   { FastLED.setBrightness(BRIGHTNESS/8); }
//    AT(0,3,16.000)   { FastLED.setBrightness(BRIGHTNESS/16); }
//  FROM(0,3,17.000) { fadeToBlack(); }  
  //  AT(0,3,18.000)   { RestartPerformance(); }
}


void loop()
{
  // Set the current timecode, based on when the performance started
  gTimeCode = millis() - gTimeCodeBase;

  Performance();

  // send the 'leds' array out to the actual LED strip
  FastLED.show();  
  // insert a delay to keep the framerate modest
  FastLED.delay(1000/FRAMES_PER_SECOND); 

  // For demo purposes, restart the performance any time we read
  // the letter "r" character from the serial port.  Type "r" into 
  // the Arduino serial monitor and press return to restart the performance.
  // In practice, you could have this check a 'restart' button, or something similar.
  // if( Serial.read() == 'r') RestartPerformance();

  // do some periodic updates
  EVERY_N_MILLISECONDS( 20 ) { gHue++; } // slowly cycle the "base color" through the rainbow
    
}


void RestartPerformance()
{
  gLastTimeCodeDoneAt = 0;
  gLastTimeCodeDoneFrom = 0;
  gTimeCodeBase = millis();
}

void rainbow() 
{
  // FastLED's built-in rainbow generator
  fill_rainbow( leds, NUM_LEDS, gHue, 7);
}

void rainbowWithGlitter() 
{
  // built-in FastLED rainbow, plus some random sparkly glitter
  rainbow();
  addGlitter(80);
}

void addGlitter( fract8 chanceOfGlitter) 
{
  if( random8() < chanceOfGlitter) {
    leds[ random16(NUM_LEDS) ] += CRGB::White;
  }
}

void confetti() 
{
  // random colored speckles that blink in and fade smoothly
  fadeToBlackBy( leds, NUM_LEDS, 10);
  int pos = random16(NUM_LEDS);
  leds[pos] += CHSV( gHue + random8(64), 200, 255);
}

void bpm()
{
  // colored stripes pulsing at a defined Beats-Per-Minute (BPM)
  uint8_t BeatsPerMinute = 62;
  CRGBPalette16 palette = PartyColors_p;
  uint8_t beat = beatsin8( BeatsPerMinute, 64, 255);
  for( int i = 0; i < NUM_LEDS; i++) { //9948
    leds[i] = ColorFromPalette(palette, gHue+(i*2), beat-gHue+(i*10));
  }
}

void juggle() {
  // eight colored dots, weaving in and out of sync with each other
  fadeToBlackBy( leds, NUM_LEDS, 20);
  byte dothue = 0;
  for( int i = 0; i < 8; i++) {
    leds[beatsin16(i+7,0,NUM_LEDS -1)] |= CHSV(dothue, 200, 255);
    dothue += 32;
  }
}

void sinelon()
{
  // a colored dot sweeping back and forth, with fading trails
  fadeToBlackBy( leds, NUM_LEDS, 20);
  int pos = beatsin16(13,0,NUM_LEDS -1);
  leds[pos] += CHSV( gHue, 255, 192);
}

//void twosinelon()
//{
//  // a colored dot sweeping back and forth, with fading trails
//  fadeToBlackBy( leds, NUM_LEDS, 20);
//  int pos = beatsin16(13,0,NUM_LEDS -1);
//  int pos2 = beatsin16(13,NUM_LEDS -1,1);
//  leds[pos] += CHSV( gHue, 255, 192);
//  leds[pos2] += CHSV( gHue, 255, 192);
//}

// An animation to play while the crowd goes wild after the big performance
void applause()
{
  static uint16_t lastPixel = 0;
  fadeToBlackBy( leds, NUM_LEDS, 32);
  leds[lastPixel] = CHSV(random8(HUE_BLUE,HUE_PURPLE),255,255);
  lastPixel = random16(NUM_LEDS);
  leds[lastPixel] = CRGB::White;
}

// An "animation" to just fade to black.  Useful as the last track
// in a non-looping performance.
void fadeToBlack()
{
  fadeToBlackBy( leds, NUM_LEDS, 1);
}


//big fire
const byte dataA[] PROGMEM = {3,0,0,3,0,0,3,0,0,3,0,0,3,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0,0};
void povA() {
  int pixels = 48;
  int frames = 16;
  int fps = 600;
  static int currentFrame = 0;

  for (int i=0; i<NUM_LEDS; i++) {
    int pixelIndex = i % pixels;
    int index = currentFrame*pixels*3 + pixelIndex*3;

    // Note: We're using pgm_read_byte_near to read bytes out of the data array stored in PROGMEM. These functions are not required for all configurations
    leds[i] = CRGB (pgm_read_byte_near(dataA+index),pgm_read_byte_near(dataA+index+1),pgm_read_byte_near(dataA+index+2));
//    leds[i] = leds[i]-;
  }
  FastLED.show();
  currentFrame ++;
  if (currentFrame >= frames) currentFrame = 0;
}

//big lightning
const byte dataB[] PROGMEM = {9,1,21,9,1,21,9,1,21,9,1,21,9,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1,21};
void povB() {
  int pixels = 45;
  int frames = 22;
  int fps = 1;
  static int currentFrame = 0;

  for (int i=0; i<NUM_LEDS; i++) {
    int pixelIndex = i % pixels;
    int index = currentFrame*pixels*3 + pixelIndex*3;

    // Note: We're using pgm_read_byte_near to read bytes out of the data array stored in PROGMEM. These functions are not required for all configurations
    leds[i] = CRGB(pgm_read_byte_near(dataB+index),pgm_read_byte_near(dataB+index+1),pgm_read_byte_near(dataB+index+2));
  }
  FastLED.show();
  currentFrame ++;
  if (currentFrame >= frames) currentFrame = 0;
}

//small fire
const byte dataC[] PROGMEM = {0,0,0,0,0,0,0,0,0,0,0,0,0,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0,0};
void povC() {
  int pixels = 90;
  int frames = 36;
  int fps = 1;
  static int currentFrame = 0;

  for (int i=0; i<NUM_LEDS; i++) {
    int pixelIndex = i % pixels;
    int index = currentFrame*pixels*3 + pixelIndex*3;

    // Note: We're using pgm_read_byte_near to read bytes out of the data array stored in PROGMEM. These functions are not required for all configurations
    leds[i] = CRGB(pgm_read_byte_near(dataC+index),pgm_read_byte_near(dataC+index+1),pgm_read_byte_near(dataC+index+2));
  }
  FastLED.show();
  currentFrame ++;
  if (currentFrame >= frames) currentFrame = 0;
}


//small lightning
const byte dataD[] PROGMEM = {0,1,5,4,0,6,4,0,6,0,1,0,0,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92,199};
void povD() {
  int pixels = 47;
  int frames = 16;
  int fps = 1;
  static int currentFrame = 0;

  for (int i=0; i<NUM_LEDS; i++) {
    int pixelIndex = i % pixels;
    int index = currentFrame*pixels*3 + pixelIndex*3;

    // Note: We're using pgm_read_byte_near to read bytes out of the data array stored in PROGMEM. These functions are not required for all configurations
    leds[i] = CRGB(pgm_read_byte_near(dataD+index),pgm_read_byte_near(dataD+index+1),pgm_read_byte_near(dataD+index+2));
  }
  FastLED.show();
  currentFrame ++;
  if (currentFrame >= frames) currentFrame = 0;
}

void lightning() 
{
  for (int flashCounter = 0; flashCounter < random8(3,FLASHES); flashCounter++)
  {
    if(flashCounter == 0) dimmer = 5;     // the brightness of the leader is scaled down by a factor of 5
    else dimmer = random8(1,3);           // return strokes are brighter than the leader
    
    FastLED.showColor(CHSV(255, 0, 255/dimmer));
    delay(random8(4,10));                 // each flash only lasts 4-10 milliseconds
    FastLED.showColor(CHSV(255, 0, 0));
    
    if (flashCounter == 0) delay (150);   // longer delay until next flash after the leader
    delay(50+random8(100));               // shorter delay between strokes  
  }
  delay(random8(FREQUENCY)*10);          // delay between strikes
}

void meteor(){
  // slide all the pixels down one in the array
  memmove8( &leds[1], &leds[0], (NUM_LEDS - 1) * 3 );

  // increment the meteor display frame
  idex++;
  // make sure we don't drift into space
  if ( idex > meteorLength ) {
    idex = 0;
    // cycle through hues in each successive meteor tail
    hue += 32;  
  }

  // this switch controls the actual meteor animation, i.e., what gets placed in the
  // first position and then subsequently gets moved down the strip by the memmove above
  switch ( idex ) {
  case 0:
    leds[0] = CRGB(200,200,200); 
    break;
  case 1:
    leds[0] = CHSV((hue - 20), 255, 210); 
    break;
  case 2:
    leds[0] = CHSV((hue - 22), 255, 180); 
    break;
  case 3:
    leds[0] = CHSV((hue - 23), 255, 150); 
    break;
  case 4:
    leds[0] = CHSV((hue - 24), 255, 110); 
    break;
  case 5:
    leds[0] = CHSV((hue - 25), 255, 90); 
    break;
  case 6:
    leds[0] = CHSV((hue - 26), 160, 60); 
    break;
  case 7:
    leds[0] = CHSV((hue - 27), 140, 40); 
    break;
  case 8:
    leds[0] = CHSV((hue - 28), 120, 20); 
    break;
  case 9:
    leds[0] = CHSV((hue - 29), 100, 20); 
    break;
  default:
    leds[0] = CRGB::Black; 
  }

  // show the blinky
  FastLED.show();  
  // control the animation speed/frame rate
  // delay(20);
} 

void colorshift() {
    //beatsin16 is a function on the FastLED library generating sinwave, (5) is bpm, (0,255) is value range.
    //value range will create the breathing effect 
    //int pos = beatsin16(5,0,192); // generating the sinwave 
    fill_solid(leds, NUM_LEDS, CHSV( gHue, 255, 255)); // CHSV (hue, saturation, value);
    FastLED.show();
    EVERY_N_MILLISECONDS(100) {gHue++;} 
    // shifting the HUE value by incrementing every millisecond this creates the spectrum wave

    /* spectrum wave
     * fill_solid(leds, NUM_LEDS, CHSV( gHue, 255, 255)); // remove pos
     * FastLED.show();
     * EVERY_N_MILLISECONDS(100) {gHue++;} 
     */
     //additional codes, just to share
    /* color spectrum generator
     *  fill_rainbow( leds, NUM_LEDS, gHue, 3);
     */
}

void strobe() {
  if (millis() - lastRun > pause) {
    if (style) {
      LEDS.showColor(CRGB::White);
    } else {
      LEDS.showColor(CRGB::Black);
    }
    style = !style;
    lastRun = millis();
  }
}

//Rainbow chase stuff

void setPixel(int Pixel, byte red, byte green, byte blue) {
 #ifdef ADAFRUIT_NEOPIXEL_H 
   // NeoPixel
   strip.setPixelColor(Pixel, strip.Color(red, green, blue));
 #endif
 #ifndef ADAFRUIT_NEOPIXEL_H 
   // FastLED
   leds[Pixel].r = red;
   leds[Pixel].g = green;
   leds[Pixel].b = blue;
 #endif
}

byte * Wheel(byte WheelPos) {
  static byte c[3];
  
  if(WheelPos < 85) {
   c[0]=WheelPos * 3;
   c[1]=255 - WheelPos * 3;
   c[2]=0;
  } else if(WheelPos < 170) {
   WheelPos -= 85;
   c[0]=255 - WheelPos * 3;
   c[1]=0;
   c[2]=WheelPos * 3;
  } else {
   WheelPos -= 170;
   c[0]=0;
   c[1]=WheelPos * 3;
   c[2]=255 - WheelPos * 3;
  }

  return c;
}

// theaterChaseRainbow(50);
void theaterChaseRainbow() {
  byte *c;
  
  for (int j=0; j < 256; j++) {     // cycle all 256 colors in the wheel
    for (int q=0; q < 3; q++) {
        for (int i=0; i < NUM_LEDS; i=i+3) {
          c = Wheel( (i+j) % 255);
          setPixel(i+q, *c, *(c+1), *(c+2));    //turn every third pixel on
        }
         FastLED.show();
       
//        delay(SpeedDelay);
       
        for (int i=0; i < NUM_LEDS; i=i+3) {
          setPixel(i+q, 0,0,0);        //turn every third pixel off
        }
    }
  }
}
